## meta/conf/distro/include/default-versions.inc
```bitbake
#
# Default preferred versions
#

PREFERRED_VERSION_openssl = "1.1.0g"
PREFERRED_VERSION_openssl-native = "1.1.0g"
PREFERRED_VERSION_nativesdk-openssl = "1.1.0g"
```
